/dts-v1/;  
/plugin/;  

/ {
    compatible = "brcm,bcm2835";

    fragment@0 {
        target = <&spidev0>;
        __overlay__ {
            status = "disabled";
        };
    };

    fragment@1 {
        target = <&spi0>;
        __overlay__ {
            status = "okay";
            #address-cells = <1>;
            #size-cells = <0>;

            recipe18: mcp3208@0 {
                compatible = "brcm,recipe18";
                reg = <0x0>;
                spi-max-frequency = <1000000>;
                spi-bits-per-word = <8>;
                //spi-cpol;
                //spi-cpha;
                status = "okay";
            };
        };
    };
};
